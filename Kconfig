## Kconfig
```kconfig
mainmenu "zOS/$ZOS_ARCH Configuration"

config ZOS_ARCH
    string
    option env="ZOS_ARCH"

source "kernel/core/Kconfig"
source "userland/Kconfig"
```

## kernel/core/Kconfig
```kconfig
menu "Core configuration (developer only)"

config CONSOLE
    bool "Generic console module"
    default y

config PANIC
    bool "Kernel panic utility"
    default y
    depends on CONSOLE

config MODULE
    bool "Early boot module support"
    default y
    depends on PANIC

config MEMORY
    bool "Generic memory module"
    default y
    depends on MODULE

config PROCESS
    bool "Generic process module"
    default y
    depends on MEMORY

config INTERRUPT
    bool "Generic interrupt module"
    default y
    depends on MEMORY
    depends on PROCESS

config TIMER
    bool "Generic timer module"
    default y
    depends on INTERRUPT

config VFS
    bool "VFS Components"
    default y
    depends on MEMORY
    depends on PROCESS

config DEVFS
    bool "Add devfs support"
    default y
    depends on VFS

config SYSCALL
    bool "Syscall module"
    default y
    depends on MEMORY
    depends on PROCESS

config SCHEDULER
    bool "Scheduler module"
    default y
    depends on TIMER

endmenu
```

## userland/Kconfig
```kconfig
menu "Userland"

source "userland/driver/Kconfig"
source "userland/bin/Kconfig"

endmenu
```

## userland/bin/Kconfig
```kconfig
menu "Binaries"

config BUILD_INIT
    bool "Init"
    default y

config BUILD_SHELL
    bool "Shell"
    default y
    depends on BUILD_TTY

config BUILD_CAT
    bool "Cat"
    default y
    depends on BUILD_SHELL

config BUILD_STAT
    bool "Stat"
    default y
    depends on BUILD_SHELL

config BUILD_LS
    bool "Ls"
    default y
    depends on BUILD_SHELL

endmenu
```

## userland/driver/Kconfig
```kconfig
menu "Driver"

source "userland/driver/$ZOS_ARCH/Kconfig"

config BUILD_EXT2
    bool "Ext2 filesystem"
    default y

config BUILD_KBD
    bool "Keyboard driver"
    default y

config BUILD_NULL
    bool "Null driver"
    default y

config BUILD_RAMD
    bool "Ram disk driver"
    default y

config BUILD_VIDEO
    bool "Video driver"
    default y

config BUILD_TTY
    bool "TTY Driver"
    depends on BUILD_KBD && BUILD_VIDEO
    default y

endmenu
```

## userland/driver/i386/Kconfig
```kconfig
menu "Disk"

config BUILD_ATA
    bool "ATA disk"
    default y

config BUILD_AHCI
    bool "AHCI disk"
    default n

endmenu
```
